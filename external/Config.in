## external/Config.in
```kconfig
menu "Pingo OS"
source "$BR2_EXTERNAL_PINGO_PATH/package/h700-suspend-stub/Config.in"
source "$BR2_EXTERNAL_PINGO_PATH/package/libretro-gambatte/Config.in"
source "$BR2_EXTERNAL_PINGO_PATH/package/libretro-mgba/Config.in"
source "$BR2_EXTERNAL_PINGO_PATH/package/libretro-cores.in"
source "$BR2_EXTERNAL_PINGO_PATH/package/font-inter/Config.in"
source "$BR2_EXTERNAL_PINGO_PATH/package/pingo-frontend/Config.in"
source "$BR2_EXTERNAL_PINGO_PATH/package/rocknix-joypad/Config.in"
endmenu
```

## external/configs/pingo_rg35xxh_defconfig
```kconfig
# Pingo OS by Retrogamer Brasil - Anbernic RG35XX-H (Allwinner H700)
# Fase 0: boot, tela, botões, som, bateria, Wi-Fi e suspend. GPU (Panfrost) entra na próxima etapa.

# Arquitetura
BR2_aarch64=y
BR2_cortex_a53=y

# Toolchain externa (Bootlin, glibc)
BR2_TOOLCHAIN_EXTERNAL=y
BR2_TOOLCHAIN_EXTERNAL_BOOTLIN=y
BR2_TOOLCHAIN_EXTERNAL_BOOTLIN_AARCH64_GLIBC_STABLE=y

# Sistema
BR2_GLOBAL_PATCH_DIR="$(BR2_EXTERNAL_PINGO_PATH)/board/h700/patches $(BR2_EXTERNAL_PINGO_PATH)/board/h700/patches-pingo"
BR2_TARGET_GENERIC_HOSTNAME="pingo"
BR2_TARGET_GENERIC_ISSUE="Pingo OS by Retrogamer Brasil"
BR2_TARGET_GENERIC_ROOT_PASSWD="pingo"
BR2_INIT_BUSYBOX=y
BR2_ROOTFS_DEVICE_CREATION_DYNAMIC_EUDEV=y
# BR2_TARGET_GENERIC_REMOUNT_ROOTFS_RW is not set
BR2_SYSTEM_DHCP=""
BR2_TARGET_TZ_INFO=y
BR2_TARGET_LOCALTIME="America/Sao_Paulo"
BR2_ROOTFS_OVERLAY="$(BR2_EXTERNAL_PINGO_PATH)/board/h700/rootfs-overlay"
BR2_ROOTFS_POST_BUILD_SCRIPT="$(BR2_EXTERNAL_PINGO_PATH)/board/h700/post-build.sh"
BR2_ROOTFS_POST_IMAGE_SCRIPT="$(BR2_EXTERNAL_PINGO_PATH)/board/h700/post-image.sh"
BR2_ROOTFS_POST_SCRIPT_ARGS="$(BR2_EXTERNAL_PINGO_PATH)/board/h700/rg35xxh"

# Kernel: 7.2 + patches/DTs do ROCKNIX
BR2_LINUX_KERNEL=y
BR2_LINUX_KERNEL_CUSTOM_VERSION=y
BR2_LINUX_KERNEL_CUSTOM_VERSION_VALUE="7.2"
BR2_LINUX_KERNEL_USE_CUSTOM_CONFIG=y
BR2_LINUX_KERNEL_CUSTOM_CONFIG_FILE="$(BR2_EXTERNAL_PINGO_PATH)/board/h700/linux-rocknix.config"
BR2_LINUX_KERNEL_CONFIG_FRAGMENT_FILES="$(BR2_EXTERNAL_PINGO_PATH)/board/h700/linux-pingo.fragment"
BR2_LINUX_KERNEL_DTS_SUPPORT=y
BR2_LINUX_KERNEL_INTREE_DTS_NAME="allwinner/sun50i-h700-anbernic-rg35xx-h allwinner/sun50i-h700-anbernic-rg35xx-h-rev6-panel allwinner/sun50i-h700-anbernic-rg40xx-h allwinner/sun50i-h700-anbernic-rg40xx-h-v2-panel"
BR2_LINUX_KERNEL_NEEDS_HOST_OPENSSL=y
BR2_LINUX_KERNEL_NEEDS_HOST_LIBELF=y

# Bootloader: TF-A 2.12 (como no ROCKNIX) + U-Boot 2026.01 LPDDR4
BR2_TARGET_ARM_TRUSTED_FIRMWARE=y
BR2_TARGET_ARM_TRUSTED_FIRMWARE_CUSTOM_VERSION=y
BR2_TARGET_ARM_TRUSTED_FIRMWARE_CUSTOM_VERSION_VALUE="v2.12.0"
BR2_TARGET_ARM_TRUSTED_FIRMWARE_PLATFORM="sun50i_h616"
BR2_TARGET_UBOOT=y
BR2_TARGET_UBOOT_BUILD_SYSTEM_KCONFIG=y
BR2_TARGET_UBOOT_CUSTOM_VERSION=y
BR2_TARGET_UBOOT_CUSTOM_VERSION_VALUE="2026.01"
BR2_TARGET_UBOOT_BOARD_DEFCONFIG="anbernic_rg35xx_h700_lpddr4"
BR2_TARGET_UBOOT_NEEDS_DTC=y
BR2_TARGET_UBOOT_NEEDS_PYLIBFDT=y
BR2_TARGET_UBOOT_NEEDS_PYELFTOOLS=y
BR2_TARGET_UBOOT_NEEDS_OPENSSL=y
BR2_TARGET_UBOOT_NEEDS_GNUTLS=y
BR2_TARGET_UBOOT_NEEDS_ATF_BL31=y
BR2_TARGET_UBOOT_SPL=y
BR2_TARGET_UBOOT_SPL_NAME="u-boot-sunxi-with-spl.bin"
BR2_TARGET_UBOOT_CUSTOM_MAKEOPTS="SCP=/dev/null"

# Imagem
BR2_TARGET_ROOTFS_SQUASHFS=y
BR2_TARGET_ROOTFS_SQUASHFS4_ZSTD=y
# BR2_TARGET_ROOTFS_TAR is not set
BR2_PACKAGE_HOST_GENIMAGE=y
BR2_PACKAGE_HOST_DOSFSTOOLS=y
BR2_PACKAGE_HOST_MTOOLS=y
BR2_PACKAGE_HOST_UBOOT_TOOLS=y

# Drivers e firmwares
BR2_PACKAGE_ROCKNIX_JOYPAD=y
BR2_PACKAGE_LINUX_FIRMWARE=y
BR2_PACKAGE_LINUX_FIRMWARE_RTL_RTW88=y
BR2_PACKAGE_LINUX_FIRMWARE_RTL_88XX_BT=y
BR2_PACKAGE_KMOD=y
BR2_PACKAGE_KMOD_TOOLS=y

# Ferramentas de teste da Fase 0
BR2_PACKAGE_EVTEST=y
BR2_PACKAGE_ALSA_UTILS=y
BR2_PACKAGE_ALSA_UTILS_APLAY=y
BR2_PACKAGE_ALSA_UTILS_AMIXER=y
BR2_PACKAGE_ALSA_UTILS_ALSAMIXER=y
BR2_PACKAGE_ALSA_UTILS_SPEAKER_TEST=y
BR2_PACKAGE_LIBDRM=y
BR2_PACKAGE_LIBDRM_INSTALL_TESTS=y
BR2_PACKAGE_I2C_TOOLS=y

# Armazenamento
BR2_PACKAGE_UTIL_LINUX=y
BR2_PACKAGE_UTIL_LINUX_BINARIES=y
BR2_PACKAGE_EXFATPROGS=y
BR2_PACKAGE_DOSFSTOOLS=y
BR2_PACKAGE_DOSFSTOOLS_FSCK_FAT=y

# Rede
BR2_PACKAGE_IW=y
BR2_PACKAGE_WPA_SUPPLICANT=y
BR2_PACKAGE_WPA_SUPPLICANT_PASSPHRASE=y
BR2_PACKAGE_WPA_SUPPLICANT_CLI=y
BR2_PACKAGE_WIRELESS_REGDB=y
BR2_PACKAGE_DROPBEAR=y
BR2_PACKAGE_BUSYBOX_CONFIG_FRAGMENT_FILES="$(BR2_EXTERNAL_PINGO_PATH)/board/h700/busybox.fragment"
BR2_PACKAGE_H700_SUSPEND_STUB=y
# GPU: Mali-G31 (Panfrost) via Mesa, SDL2 em KMS/DRM + GLES
BR2_PACKAGE_MESA3D=y
BR2_PACKAGE_MESA3D_LLVM=y
BR2_PACKAGE_MESA3D_GALLIUM_DRIVER_PANFROST=y
BR2_PACKAGE_MESA3D_GBM=y
BR2_PACKAGE_MESA3D_OPENGL_EGL=y
BR2_PACKAGE_MESA3D_OPENGL_ES=y
BR2_PACKAGE_KMSCUBE=y
BR2_PACKAGE_SDL2=y
BR2_PACKAGE_SDL2_KMSDRM=y
BR2_PACKAGE_SDL2_OPENGLES=y
```

## external/package/font-inter/Config.in
```kconfig
config BR2_PACKAGE_FONT_INTER
	bool "font-inter"
	help
	  Fonte Inter (pesos 400, 500 e 600), usada pela interface do
	  Pingo OS. Licença SIL Open Font License 1.1.

	  https://rsms.me/inter/
```

## external/package/h700-suspend-stub/Config.in
```kconfig
config BR2_PACKAGE_H700_SUSPEND_STUB
	bool "h700-suspend-stub"
	depends on BR2_TARGET_ARM_TRUSTED_FIRMWARE
	depends on BR2_TARGET_UBOOT
	help
	  Programa em SRAM que o TF-A executa no PSCI SYSTEM_SUSPEND do
	  H616/H700: coloca a DRAM em self-refresh e a reinicializa no
	  resume. Ativa o suspend profundo ("mem" = deep).

	  Compilado a partir do driver de DRAM do U-Boot; o TF-A embute
	  o binário (SUNXI_SYSTEM_SUSPEND=1).

	  https://github.com/MagnominusGit/h700-suspend-stub
```

## external/package/libchdr/Config.in
```kconfig
config BR2_PACKAGE_LIBCHDR
	bool "libchdr"
	help
	  Leitura de imagens de disco CHD (MAME), com o zlib, o LZMA e o
	  zstd que vêm junto (BSD-3-Clause). Biblioteca estática para o
	  pingo-retro identificar jogos .chd no RetroAchievements.

	  https://github.com/rtissera/libchdr
```

## external/package/libretro-beetle-ngp/Config.in
```kconfig
config BR2_PACKAGE_LIBRETRO_BEETLE_NGP
	bool "libretro-beetle-ngp"
	depends on BR2_INSTALL_LIBSTDCPP
	help
	  Core libretro mednafen_ngp (GPL-2.0).

	  https://github.com/libretro/beetle-ngp-libretro
```

## external/package/libretro-beetle-pce-fast/Config.in
```kconfig
config BR2_PACKAGE_LIBRETRO_BEETLE_PCE_FAST
	bool "libretro-beetle-pce-fast"
	depends on BR2_INSTALL_LIBSTDCPP
	help
	  Core libretro mednafen_pce_fast (GPL-2.0).

	  https://github.com/libretro/beetle-pce-fast-libretro
```

## external/package/libretro-beetle-vb/Config.in
```kconfig
config BR2_PACKAGE_LIBRETRO_BEETLE_VB
	bool "libretro-beetle-vb"
	depends on BR2_INSTALL_LIBSTDCPP
	help
	  Core libretro mednafen_vb (GPL-2.0).

	  https://github.com/libretro/beetle-vb-libretro
```

## external/package/libretro-beetle-wswan/Config.in
```kconfig
config BR2_PACKAGE_LIBRETRO_BEETLE_WSWAN
	bool "libretro-beetle-wswan"
	depends on BR2_INSTALL_LIBSTDCPP
	help
	  Core libretro mednafen_wswan (GPL-2.0).

	  https://github.com/libretro/beetle-wswan-libretro
```

## external/package/libretro-bluemsx/Config.in
```kconfig
config BR2_PACKAGE_LIBRETRO_BLUEMSX
	bool "libretro-bluemsx"
	depends on BR2_INSTALL_LIBSTDCPP
	help
	  Core libretro bluemsx (blueMSX (não comercial)).

	  https://github.com/libretro/blueMSX-libretro
```

## external/package/libretro-fbneo/Config.in
```kconfig
config BR2_PACKAGE_LIBRETRO_FBNEO
	bool "libretro-fbneo"
	depends on BR2_INSTALL_LIBSTDCPP
	help
	  Core libretro de arcade (FinalBurn Neo, licença não comercial).
	  Instala também a tabela de nomes do romset desta versão
	  (/usr/share/pingo/arcade/fbneo.tsv), feita a partir do DAT.

	  https://github.com/libretro/FBNeo
```

## external/package/libretro-fceumm/Config.in
```kconfig
config BR2_PACKAGE_LIBRETRO_FCEUMM
	bool "libretro-fceumm"
	depends on BR2_INSTALL_LIBSTDCPP
	help
	  Core libretro fceumm (GPL-2.0).

	  https://github.com/libretro/libretro-fceumm
```

## external/package/libretro-gambatte/Config.in
```kconfig
config BR2_PACKAGE_LIBRETRO_GAMBATTE
	bool "libretro-gambatte"
	depends on BR2_INSTALL_LIBSTDCPP
	help
	  Core libretro de Game Boy / Game Boy Color (gambatte).
	  Instala em /usr/lib/libretro/gambatte_libretro.so.

	  https://github.com/libretro/gambatte-libretro
```

## external/package/libretro-genesis-plus-gx/Config.in
```kconfig
config BR2_PACKAGE_LIBRETRO_GENESIS_PLUS_GX
	bool "libretro-genesis-plus-gx"
	depends on BR2_INSTALL_LIBSTDCPP
	help
	  Core libretro genesis_plus_gx (Genesis Plus GX (não comercial)).

	  https://github.com/libretro/Genesis-Plus-GX
```

## external/package/libretro-handy/Config.in
```kconfig
config BR2_PACKAGE_LIBRETRO_HANDY
	bool "libretro-handy"
	depends on BR2_INSTALL_LIBSTDCPP
	help
	  Core libretro handy (Zlib).

	  https://github.com/libretro/libretro-handy
```

## external/package/libretro-mgba/Config.in
```kconfig
config BR2_PACKAGE_LIBRETRO_MGBA
	bool "libretro-mgba"
	depends on BR2_INSTALL_LIBSTDCPP
	help
	  Core libretro de Game Boy Advance (mGBA, MPL-2.0).

	  https://github.com/libretro/mgba
```

## external/package/libretro-pcsx-rearmed/Config.in
```kconfig
config BR2_PACKAGE_LIBRETRO_PCSX_REARMED
	bool "libretro-pcsx-rearmed"
	depends on BR2_INSTALL_LIBSTDCPP
	help
	  Core libretro pcsx_rearmed (GPL-2.0).

	  https://github.com/libretro/pcsx_rearmed
```

## external/package/libretro-picodrive/Config.in
```kconfig
config BR2_PACKAGE_LIBRETRO_PICODRIVE
	bool "libretro-picodrive"
	depends on BR2_INSTALL_LIBSTDCPP
	help
	  Core libretro picodrive (PicoDrive (não comercial)).

	  https://github.com/libretro/picodrive
```

## external/package/libretro-pokemini/Config.in
```kconfig
config BR2_PACKAGE_LIBRETRO_POKEMINI
	bool "libretro-pokemini"
	depends on BR2_INSTALL_LIBSTDCPP
	help
	  Core libretro pokemini (GPL-3.0).

	  https://github.com/libretro/PokeMini
```

## external/package/libretro-prosystem/Config.in
```kconfig
config BR2_PACKAGE_LIBRETRO_PROSYSTEM
	bool "libretro-prosystem"
	depends on BR2_INSTALL_LIBSTDCPP
	help
	  Core libretro prosystem (GPL-2.0).

	  https://github.com/libretro/prosystem-libretro
```

## external/package/libretro-snes9x/Config.in
```kconfig
config BR2_PACKAGE_LIBRETRO_SNES9X
	bool "libretro-snes9x"
	depends on BR2_INSTALL_LIBSTDCPP
	help
	  Core libretro snes9x (Snes9x (não comercial)).

	  https://github.com/libretro/snes9x
```

## external/package/libretro-stella2014/Config.in
```kconfig
config BR2_PACKAGE_LIBRETRO_STELLA2014
	bool "libretro-stella2014"
	depends on BR2_INSTALL_LIBSTDCPP
	help
	  Core libretro stella2014 (GPL-2.0).

	  https://github.com/libretro/stella2014-libretro
```

## external/package/pingo-frontend/Config.in
```kconfig
config BR2_PACKAGE_PINGO_FRONTEND
	bool "pingo-frontend"
	depends on BR2_PACKAGE_SDL2
	select BR2_PACKAGE_SDL2_TTF
	select BR2_PACKAGE_FONT_INTER
	select BR2_PACKAGE_ALSA_LIB
	select BR2_PACKAGE_LIBZIP
	select BR2_PACKAGE_RCHEEVOS
	select BR2_PACKAGE_LIBCURL
	select BR2_PACKAGE_MBEDTLS
	select BR2_PACKAGE_CA_CERTIFICATES
	help
	  Interface do Pingo OS: pingo-launcher (tela inicial e listas
	  de jogos), pingo-retro (frontend libretro) e pingo-shell (o
	  laço que liga os dois). RetroAchievements pelo rcheevos e libcurl
	  (TLS com mbed TLS).
```

## external/package/rcheevos/Config.in
```kconfig
config BR2_PACKAGE_RCHEEVOS
	bool "rcheevos"
	help
	  Biblioteca oficial do RetroAchievements (MIT): cliente,
	  identificação dos jogos (hash) e leitura da memória dos cores
	  libretro. Compilada como biblioteca estática para o pingo-retro.

	  https://github.com/RetroAchievements/rcheevos
```
